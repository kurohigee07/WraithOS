## wraithos/buildroot-configs/wraithos_aarch64_defconfig
```kconfig
# Architecture
BR2_aarch64=y
BR2_cortex_a72=y

# Toolchain (musl, match x86 WraithOS)
BR2_TOOLCHAIN_BUILDROOT_MUSL=y

# System
BR2_TARGET_GENERIC_HOSTNAME="wraithos"
BR2_TARGET_GENERIC_ISSUE=""
BR2_TARGET_GENERIC_GETTY_PORT="ttyAMA0"

# Init
BR2_INIT_BUSYBOX=y

# Rootfs overlay
BR2_ROOTFS_OVERLAY="/home/opc/wraithos-aarch64-br2-ext/board/wraithos/rootfs_overlay"

# Kernel 6.6 + fragment
BR2_LINUX_KERNEL=y
BR2_LINUX_KERNEL_CUSTOM_VERSION=y
BR2_LINUX_KERNEL_CUSTOM_VERSION_VALUE="6.6"
BR2_LINUX_KERNEL_USE_ARCH_DEFAULT_CONFIG=y
BR2_LINUX_KERNEL_CONFIG_FRAGMENT_FILES="/home/opc/wraithos-aarch64-br2-ext/board/wraithos/kernel.fragment"
BR2_LINUX_KERNEL_IMAGE=y

# Rootfs ext4 (test boot; squashfs+AB nanti)
# BR2_TARGET_ROOTFS_EXT2 is not set
# BR2_TARGET_ROOTFS_EXT2_4 is not set
# BR2_TARGET_ROOTFS_EXT2_SIZE="300M"
BR2_TARGET_ROOTFS_TAR=n

# Runtime packages
BR2_PACKAGE_OPENSSL=y
BR2_PACKAGE_SQLITE=y
BR2_PACKAGE_CA_CERTIFICATES=y
BR2_PACKAGE_IPROUTE2=y
BR2_PACKAGE_IPTABLES=y
BR2_PACKAGE_BASH=y
BR2_PACKAGE_BASH=y
BR2_TARGET_ROOTFS_SQUASHFS=y
BR2_TARGET_GRUB2=y
BR2_TARGET_GRUB2_ARM64_EFI=y
BR2_TARGET_GRUB2_INSTALL_TOOLS=y
BR2_TARGET_GRUB2_BUILTIN_CONFIG=""
BR2_PACKAGE_HOST_GENIMAGE=y
BR2_PACKAGE_HOST_DOSFSTOOLS=y
BR2_PACKAGE_HOST_MTOOLS=y
BR2_PACKAGE_HOST_GENEXT2FS=y
BR2_ROOTFS_POST_IMAGE_SCRIPT="/home/opc/wraithos-aarch64-br2-ext/board/wraithos/post-image-arm.sh"
BR2_ROOTFS_POST_BUILD_SCRIPT="/home/opc/wraithos-aarch64-br2-ext/board/wraithos/post-build-arm.sh"
BR2_PACKAGE_CRYPTSETUP=y
BR2_PACKAGE_E2FSPROGS=y
BR2_PACKAGE_LIBGCRYPT=y
BR2_PACKAGE_LIBUUID=y
BR2_PACKAGE_POPT=y
BR2_PACKAGE_JSON_C=y
```

## wraithos/buildroot-configs/wraithos_x86_64_defconfig
```kconfig
# Arsitektur
BR2_x86_64=y
BR2_x86_64_generic=y
BR2_TOOLCHAIN_BUILDROOT_MUSL=y
BR2_TOOLCHAIN_BUILDROOT_CXX=y
BR2_TOOLCHAIN_BUILDROOT_GLIBC=n

# Init System
BR2_INIT_SYSTEMD=y
BR2_TARGET_GENERIC_GETTY_PORT="tty1"

# Kernel (custom, di-tuning)
BR2_LINUX_KERNEL=y
BR2_LINUX_KERNEL_CUSTOM_VERSION=y
BR2_LINUX_KERNEL_CUSTOM_VERSION_VALUE="6.6"
BR2_LINUX_KERNEL_USE_ARCH_DEFAULT_CONFIG=y
BR2_LINUX_KERNEL_CONFIG_FRAGMENT_FILES="/home/opc/wraithos-br2-ext/board/wraithos/kernel.fragment"

# Filesystem SquashFS + Overlay (Level 2 spec)
BR2_TARGET_ROOTFS_SQUASHFS=y
BR2_TARGET_ROOTFS_SQUASHFS_COMP_LZ4=y
BR2_TARGET_ROOTFS_TAR=n

# Systemd + network
BR2_SYSTEM_DHCP="eth0"

# Runtime libs yang dibutuhin orchestrator
BR2_PACKAGE_OPENSSL=y
BR2_PACKAGE_SQLITE=y
BR2_PACKAGE_CA_CERTIFICATES=y

# Utils buat debug
BR2_PACKAGE_IPROUTE2=y
BR2_PACKAGE_BUSYBOX=y
BR2_PACKAGE_IPTABLES=y
BR2_PACKAGE_HTOP=y

# Overlay custom kita (systemd units, orchestrator binary)
BR2_ROOTFS_OVERLAY="/home/opc/wraithos-br2-ext/board/wraithos/rootfs_overlay"
BR2_PACKAGE_LIBCURL=y
BR2_PACKAGE_LIBCURL_CURL=y
BR2_SKIP_LEGACY=y
```
